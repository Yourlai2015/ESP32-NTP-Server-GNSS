// SSD1306 128x64 OLED 驱动（ESP32-S3 硬件 I2C）。
// 并按命令/数据批量提交，减少事务次数。

#include "oled.h"

#include "oledfont.h"
#include "esp_log.h"

static const char *TAG = "oled";

static i2c_master_bus_handle_t s_i2c_bus = NULL;
static i2c_master_dev_handle_t s_i2c_device = NULL;

// 批量缓冲：首字节是 SSD1306 控制字节（0x00=命令，0x40=数据），
// 其余为负载数据。
enum
{
	OLED_TX_BUFFER_SIZE = 129,
	OLED_CONTROL_COMMAND = 0x00,
	OLED_CONTROL_DATA = 0x40,
};

static uint8_t s_tx_buffer[OLED_TX_BUFFER_SIZE];
static size_t s_tx_length = 0;
static uint8_t s_tx_control = OLED_CONTROL_DATA;

// 发送缓冲区内容；无待发数据时调用也安全。
void OLED_Flush(void)
{
	if (s_tx_length == 0 || s_i2c_device == NULL)
		return;

	esp_err_t error = i2c_master_transmit(s_i2c_device, s_tx_buffer, s_tx_length, OLED_I2C_TIMEOUT_MS);
	if (error != ESP_OK)
		ESP_LOGW(TAG, "I2C transmit failed: %s", esp_err_to_name(error));
	s_tx_length = 0;
}

// 配置 I2C 主机总线并添加 SSD1306 设备（幂等）。
void OLED_I2C_Init(void)
{
	if (s_i2c_device != NULL)
		return;

	const i2c_master_bus_config_t bus_config = {
		.i2c_port = OLED_I2C_PORT,
		.sda_io_num = OLED_SDA_PIN,
		.scl_io_num = OLED_SCK_PIN,
		.clk_source = I2C_CLK_SRC_DEFAULT,
		.glitch_ignore_cnt = 7,
		.flags.enable_internal_pullup = true,
	};
	ESP_ERROR_CHECK(i2c_new_master_bus(&bus_config, &s_i2c_bus));

	const i2c_device_config_t device_config = {
		.dev_addr_length = I2C_ADDR_BIT_LEN_7,
		.device_address = OLED_I2C_ADDRESS,
		.scl_speed_hz = OLED_I2C_SPEED_HZ,
	};
	ESP_ERROR_CHECK(i2c_master_bus_add_device(s_i2c_bus, &device_config, &s_i2c_device));
}

// 追加一个字节；控制字节变化或缓冲写满时先刷出。
// 保持与原软件 I2C 实现相同的 OLED_WR_Byte() 对外接口。
static void oled_stage_byte(unsigned char dat, unsigned char control)
{
	if (s_i2c_device == NULL)
		return;

	if (s_tx_length == 0)
	{
		s_tx_buffer[0] = control;
		s_tx_length = 1;
		s_tx_control = control;
	}
	else if (control != s_tx_control || s_tx_length >= OLED_TX_BUFFER_SIZE)
	{
		OLED_Flush();
		s_tx_buffer[0] = control;
		s_tx_length = 1;
		s_tx_control = control;
	}

	s_tx_buffer[s_tx_length++] = (uint8_t)dat;
}

void OLED_WR_Byte(unsigned char dat, unsigned char cmd)
{
	oled_stage_byte(dat, cmd ? OLED_CONTROL_DATA : OLED_CONTROL_COMMAND);
}


// 用 fill_Data 填充整屏
void fill_picture(unsigned char fill_Data)
{
	unsigned char m, n;
	for (m = 0; m < 8; m++)
	{
		OLED_WR_Byte(0xb0 + m, 0); // 页地址 0~7
		OLED_WR_Byte(0x00, 0);     // 列低地址
		OLED_WR_Byte(0x10, 0);     // 列高地址
		for (n = 0; n < 128; n++)
		{
			OLED_WR_Byte(fill_Data, 1);
		}
	}
	OLED_Flush();
}

// 忙等延时
void Delay_50ms(unsigned int Del_50ms)
{
	esp_rom_delay_us((uint32_t)Del_50ms * 50000U);
}

void Delay_1ms(unsigned int Del_1ms)
{
	esp_rom_delay_us((uint32_t)Del_1ms * 1000U);
}

// 设置坐标
void OLED_Set_Pos(unsigned char x, unsigned char y)
{
	OLED_WR_Byte(0xb0 + y, OLED_CMD);
	OLED_WR_Byte(((x & 0xf0) >> 4) | 0x10, OLED_CMD);
	OLED_WR_Byte((x & 0x0f), OLED_CMD);
}

// 开启显示
void OLED_Display_On(void)
{
	OLED_WR_Byte(0X8D, OLED_CMD); // 使能电荷泵
	OLED_WR_Byte(0X14, OLED_CMD); // 电荷泵开
	OLED_WR_Byte(0XAF, OLED_CMD); // 显示开
	OLED_Flush();
}

// 关闭显示
void OLED_Display_Off(void)
{
	OLED_WR_Byte(0X8D, OLED_CMD); // 使能电荷泵
	OLED_WR_Byte(0X10, OLED_CMD); // 电荷泵关
	OLED_WR_Byte(0XAE, OLED_CMD); // 显示关
	OLED_Flush();
}

// 清屏（全黑）
void OLED_Clear(void)
{
	u8 i, n;
	for (i = 0; i < 8; i++)
	{
		OLED_WR_Byte(0xb0 + i, OLED_CMD); // 页地址 0~7
		OLED_WR_Byte(0x00, OLED_CMD);     // 列低地址
		OLED_WR_Byte(0x10, OLED_CMD);     // 列高地址
		for (n = 0; n < 128; n++)
			OLED_WR_Byte(0, OLED_DATA);
	}
}

// 全屏点亮
void OLED_On(void)
{
	u8 i, n;
	for (i = 0; i < 8; i++)
	{
		OLED_WR_Byte(0xb0 + i, OLED_CMD); // 页地址 0~7
		OLED_WR_Byte(0x00, OLED_CMD);     // 列低地址
		OLED_WR_Byte(0x10, OLED_CMD);     // 列高地址
		for (n = 0; n < 128; n++)
			OLED_WR_Byte(1, OLED_DATA);
	}
	OLED_Flush();
}

// 在 (x,y) 显示一个 ASCII 字符，Char_Size 为字体大小（16 或 6x8）
void OLED_ShowChar(u8 x, u8 y, u8 chr, u8 Char_Size)
{
	unsigned char c = 0, i = 0;
	c = chr - ' '; // 转为字库偏移
	if (x > Max_Column - 1)
	{
		x = 0;
		y = y + 2;
	}
	if (Char_Size == 16)
	{
		OLED_Set_Pos(x, y);
		for (i = 0; i < 8; i++)
			OLED_WR_Byte(F8X16[c * 16 + i], OLED_DATA);
		OLED_Set_Pos(x, y + 1);
		for (i = 0; i < 8; i++)
			OLED_WR_Byte(F8X16[c * 16 + i + 8], OLED_DATA);
	}
	else
	{
		OLED_Set_Pos(x, y);
		for (i = 0; i < 6; i++)
			OLED_WR_Byte(F6x8[c][i], OLED_DATA);
	}
	OLED_Flush();
}

// 计算 m 的 n 次幂
static u32 oled_pow(u8 m, u8 n)
{
	u32 result = 1;
	while (n--)
		result *= m;
	return result;
}

// 在 (x,y) 显示 num，len 为位数，size2 为字体大小
void OLED_ShowNum(u8 x, u8 y, u32 num, u8 len, u8 size2)
{
	u8 t, temp;
	u8 enshow = 0;
	for (t = 0; t < len; t++)
	{
		temp = (num / oled_pow(10, len - t - 1)) % 10;
		if (enshow == 0 && t < (len - 1))
		{
			if (temp == 0)
			{
				OLED_ShowChar(x + (size2 / 2) * t, y, ' ', size2);
				continue;
			}
			else
				enshow = 1;
		}
		OLED_ShowChar(x + (size2 / 2) * t, y, temp + '0', size2);
	}
}

// 在 (x,y) 显示字符串
void OLED_ShowString(u8 x, u8 y, const char *chr, u8 Char_Size)
{
	unsigned char j = 0;
	while (chr[j] != '\0')
	{
		OLED_ShowChar(x, y, (u8)chr[j], Char_Size);
		x += 8;
		if (x > 120)
		{
			x = 0;
			y += 2;
		}
		j++;
	}
}

// 显示 128×64 位图，(x0,y0)-(x1,y1) 为列/页范围
void OLED_DrawBMP(unsigned char x0, unsigned char y0, unsigned char x1, unsigned char y1, unsigned char BMP[])
{
	unsigned int j = 0;
	unsigned char x, y;

	if (y1 % 8 == 0)
		y = y1 / 8;
	else
		y = y1 / 8 + 1;
	for (y = y0; y < y1; y++)
	{
		OLED_Set_Pos(x0, y);
		for (x = x0; x < x1; x++)
		{
			OLED_WR_Byte(BMP[j++], OLED_DATA);
		}
	}
	OLED_Flush();
}

// 初始化 SSD1306
void OLED_Init(void)
{
	OLED_I2C_Init();

	OLED_WR_Byte(0xAE, OLED_CMD); // 关闭显示
	OLED_WR_Byte(0x00, OLED_CMD); // 列低地址
	OLED_WR_Byte(0x10, OLED_CMD); // 列高地址
	OLED_WR_Byte(0x40, OLED_CMD); // 起始行地址
	OLED_WR_Byte(0xB0, OLED_CMD); // 页地址
	OLED_WR_Byte(0x81, OLED_CMD); // 对比度控制
	OLED_WR_Byte(0xFF, OLED_CMD); // 对比度值 128
	OLED_WR_Byte(0xA1, OLED_CMD); // 段重映射
	OLED_WR_Byte(0xA6, OLED_CMD); // 正常显示
	OLED_WR_Byte(0xA8, OLED_CMD); // 多路复用比(1~64)
	OLED_WR_Byte(0x3F, OLED_CMD); // 1/32 duty
	OLED_WR_Byte(0xC8, OLED_CMD); // COM 扫描方向
	OLED_WR_Byte(0xD3, OLED_CMD); // 显示偏移
	OLED_WR_Byte(0x00, OLED_CMD); //

	OLED_WR_Byte(0xD5, OLED_CMD); // 时钟分频
	OLED_WR_Byte(0x80, OLED_CMD); //

	OLED_WR_Byte(0xD8, OLED_CMD); // 关闭区域颜色模式
	OLED_WR_Byte(0x05, OLED_CMD); //

	OLED_WR_Byte(0xD9, OLED_CMD); // 预充电周期
	OLED_WR_Byte(0xF1, OLED_CMD); //

	OLED_WR_Byte(0xDA, OLED_CMD); // COM 引脚配置
	OLED_WR_Byte(0x12, OLED_CMD); //

	OLED_WR_Byte(0xDB, OLED_CMD); // Vcomh 电压
	OLED_WR_Byte(0x30, OLED_CMD); //

	OLED_WR_Byte(0x8D, OLED_CMD); // 使能电荷泵
	OLED_WR_Byte(0x14, OLED_CMD); //

	OLED_WR_Byte(0xAF, OLED_CMD); // 打开面板

	OLED_Flush();
}

const unsigned char S[] = {
	0x00, 0x00, 0x80, 0x80, 0x00, 0x00, 0x00, 0x00, 0x00, 0x00, 0x00, 0x00, 0x00, 0x00, 0x00, 0x00,
	0x00, 0x00, 0x01, 0x01, 0x01, 0x00, 0x00, 0x00, 0x00, 0x00, 0x00, 0x00, 0x00, 0x00, 0x00, 0x00,
	0x00, 0x00, 0x00, 0x00, 0x00, 0x00, 0x00, 0x00, 0x00, 0x00, 0x00, 0x00, 0x00, 0x00, 0x00, 0x00,
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	0x00, 0x00, 0x00, 0x00, 0x00, 0x07, 0x19, 0xE1, 0x03, 0x03, 0x07, 0x07, 0x0F, 0x0F, 0x0F, 0x1F,
	/* (64 X 64 )*/
};
